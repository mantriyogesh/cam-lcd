## examples/cam-lcd/sdkconfig.defaults
```kconfig
# ESP32-P4X-EYE: 16MB flash, 32MB PSRAM
CONFIG_IDF_TARGET="esp32p4"
CONFIG_ESPTOOLPY_FLASHSIZE_16MB=y
CONFIG_PARTITION_TABLE_SINGLE_APP_LARGE=y
CONFIG_SPIRAM=y
CONFIG_SPIRAM_SPEED_200M=y

# Camera: OV2710 on MIPI-CSI, 1280x720 RAW10. We crop/scale this to the 240x240 LCD.
CONFIG_CAMERA_OV2710=y
CONFIG_CAMERA_OV2710_MIPI_RAW10_1280X720_25FPS=y
CONFIG_CAMERA_OV2710_MIPI_DEFAULT_FMT_RAW10_1280X720_25FPS=y
CONFIG_ESP_VIDEO_ENABLE_MIPI_CSI_VIDEO_DEVICE=y
CONFIG_ESP_VIDEO_ENABLE_ISP_VIDEO_DEVICE=y
# Auto exposure / white balance
CONFIG_ESP_VIDEO_ENABLE_ISP_PIPELINE_CONTROLLER=y
```
